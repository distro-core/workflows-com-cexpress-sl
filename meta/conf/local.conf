## meta/conf/local.conf
```bitbake
# LAYER.conf

# Use in BBLAYERS.CONF following poky/meta and poky/meta-poky
# such that the prepend places this layer at the front of BBPATH

BBPATH .= "${LAYERDIR}:"

BBFILES += " \
${LAYERDIR}/recipes-*/*/*.bb \
${LAYERDIR}/recipes-*/*/*.bbappend \
"

BBFILE_COLLECTIONS += "distro-bsp-layer"
BBFILE_PATTERN_distro-bsp-layer = "^${LAYERDIR}/"
BBFILE_PRIORITY_distro-bsp-layer = "12"

# Requied dependency layers that are present in every build
LAYERDEPENDS_distro-layer = "core yocto openembedded-layer sota"
LAYERSERIES_COMPAT_distro-layer = "kirkstone scarthgap"

# https://docs.yoctoproject.org/ref-manual/variables.html?highlight=bbfiles_dynamic#term-BBFILES_DYNAMIC
# pathing is used roughly matching bblayers.conf; these locations are for .bb or .bbappends

BBFILES_DYNAMIC += ""

# ---
```
